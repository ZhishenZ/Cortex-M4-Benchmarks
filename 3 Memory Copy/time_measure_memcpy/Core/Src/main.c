/* USER CODE BEGIN Header */
/**
  ******************************************************************************
  * @file           : main.c
  * @brief          : Main program body
  ******************************************************************************
  * @attention
  *
  * <h2><center>&copy; Copyright (c) 2021 STMicroelectronics.
  * All rights reserved.</center></h2>
  *
  * This software component is licensed by ST under BSD 3-Clause license,
  * the "License"; You may not use this file except in compliance with the
  * License. You may obtain a copy of the License at:
  *                        opensource.org/licenses/BSD-3-Clause
  *
  ******************************************************************************
  */
/* USER CODE END Header */
/* Includes ------------------------------------------------------------------*/
#include "main.h"

/* Private includes ----------------------------------------------------------*/
/* USER CODE BEGIN Includes */

/* USER CODE END Includes */

/* Private typedef -----------------------------------------------------------*/
/* USER CODE BEGIN PTD */

/* USER CODE END PTD */

/* Private define ------------------------------------------------------------*/
/* USER CODE BEGIN PD */
enum MODE
{
	FLASHtoRAM=1, RAMtoRAM, FLASHtoCCMRAM, RAMtoCCMRAM, CCMRAMtoRAM, CCMRAMtoCCMRAM
};

int const srcArrayInFlash[1000] =
{1804289383, 846930886, 1681692777, 1714636915, 1957747793, 424238335, 719885386, 1649760492, 596516649, 1189641421, 1025202362, 1350490027, 783368690,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 1369133069,
1125898167, 1059961393, 2089018456, 628175011, 1656478042, 1131176229, 1653377373, 859484421, 1914544919, 608413784, 756898537, 1734575198,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 1100661313,
1433925857, 1141616124, 84353895, 939819582, 2001100545, 1998898814, 1548233367, 610515434, 1585990364, 1374344043, 760313750, 1477171087,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 2040651434,
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1043388777, 413360099, 1844400657, 286448566, 629580952, 396377017, 6072641, 1934392735, 620089368, 1736491298, 1396918184, 1476453195,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 745598382, 1143565421};

__attribute__((section(".ccmramdata"))) int arrayInCCMRAM1[1000] =
{1804289383, 846930886, 1681692777, 1714636915, 1957747793, 424238335, 719885386, 1649760492, 596516649, 1189641421, 1025202362, 1350490027, 783368690,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 1369133069,
1125898167, 1059961393, 2089018456, 628175011, 1656478042, 1131176229, 1653377373, 859484421, 1914544919, 608413784, 756898537, 1734575198,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 1100661313,
1433925857, 1141616124, 84353895, 939819582, 2001100545, 1998898814, 1548233367, 610515434, 1585990364, 1374344043, 760313750, 1477171087,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 2040651434,
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1043388777, 413360099, 1844400657, 286448566, 629580952, 396377017, 6072641, 1934392735, 620089368, 1736491298, 1396918184, 1476453195,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 745598382, 1143565421};

__attribute__((section(".ccmramdata"))) int arrayInCCMRAM2[1000];
/* USER CODE END PD */

/* Private macro -------------------------------------------------------------*/
/* USER CODE BEGIN PM */

/* USER CODE END PM */

/* Private variables ---------------------------------------------------------*/
TIM_HandleTypeDef htim2;

UART_HandleTypeDef huart1;

/* USER CODE BEGIN PV */

/* USER CODE END PV */

/* Private function prototypes -----------------------------------------------*/
void SystemClock_Config(void);
static void MX_GPIO_Init(void);
static void MX_TIM2_Init(void);
static void MX_USART1_UART_Init(void);
/* USER CODE BEGIN PFP */

/* USER CODE END PFP */

/* Private user code ---------------------------------------------------------*/
/* USER CODE BEGIN 0 */
#ifdef memcpyInCCMRAM
__attribute__((section(".ccmram")))
#endif
void myMemCpy(int *dest, int *src, size_t n)
{
   for (int i=0; i<(n/4); i++)
   {
	   dest[i] = src[i];
   }
}

/*void *
memcpy (void *dest, const void *src, size_t len)
{
  char *d = dest;
  const char *s = src;
  size_t len1=len/4;
  while (len1>0){
	  *d++ = *s++;
  	  *d++ = *s++;
      *d++ = *s++;
      *d++ = *s++;
      len1--;
  }

  return dest;
}*/
/* USER CODE END 0 */

/**
  * @brief  The application entry point.
  * @retval int
  */
int main(void)
{
  /* USER CODE BEGIN 1 */
	uint8_t count =0;
	uint8_t gu8_MSG[60] = {'\0'};
	int cpySize = 4000;                /* 1000 int variables, each variable has 4 bytes, 4000 bytes in total. */
	volatile uint32_t time1, time2;


	int srcArrayInRAM[1000] = {1804289383, 846930886, 1681692777, 1714636915, 1957747793, 424238335, 719885386, 1649760492, 596516649, 1189641421, 1025202362, 1350490027, 783368690,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 1369133069,
			1125898167, 1059961393, 2089018456, 628175011, 1656478042, 1131176229, 1653377373, 859484421, 1914544919, 608413784, 756898537, 1734575198,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 1100661313,
			1433925857, 1141616124, 84353895, 939819582, 2001100545, 1998898814, 1548233367, 610515434, 1585990364, 1374344043, 760313750, 1477171087,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 2040651434,
			1975960378, 317097467, 1892066601, 1376710097, 927612902, 1330573317, 603570492, 1687926652, 660260756, 959997301, 485560280, 402724286,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 269455306,
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			1043388777, 413360099, 1844400657, 286448566, 629580952, 396377017, 6072641, 1934392735, 620089368, 1736491298, 1396918184, 1476453195,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 745598382, 1143565421};
	int desArrayInRAM[1000]={0};
  /* USER CODE END 1 */

  /* MCU Configuration--------------------------------------------------------*/

  /* Reset of all peripherals, Initializes the Flash interface and the Systick. */
  HAL_Init();

  /* USER CODE BEGIN Init */

  /* USER CODE END Init */

  /* Configure the system clock */
  SystemClock_Config();

  /* USER CODE BEGIN SysInit */

  /* USER CODE END SysInit */

  /* Initialize all configured peripherals */
  MX_GPIO_Init();
  MX_TIM2_Init();
  MX_USART1_UART_Init();
  /* USER CODE BEGIN 2 */
  enum MODE mode = FLASHtoRAM;
  HAL_TIM_Base_Start(&htim2);

  /* USER CODE END 2 */

  /* Infinite loop */
  /* USER CODE BEGIN WHILE */
  while (1)
  {
    /* USER CODE END WHILE */

    /* USER CODE BEGIN 3 */

	  if(count==0){
		  switch (mode){
		  	  	  case FLASHtoRAM:
		  	  		  sprintf(gu8_MSG, "FLASH to RAM in FLASH\n\r");
		  	  		  break;
		  	  	  case RAMtoRAM:
		  	  		  sprintf(gu8_MSG, "RAM to RAM in FLASH\n\r");
		  	  		  break;
		  	  	  case FLASHtoCCMRAM:
		  	  		  sprintf(gu8_MSG, "FLASH to CCMRAM in FLASH\n\r");
		  	  		  break;
		  	  	  case RAMtoCCMRAM:
		  	  		  sprintf(gu8_MSG, "RAM to CCMRAM in FLASH\n\r");
		  	  		  break;
		  	  	  case CCMRAMtoRAM:
		  	  		  sprintf(gu8_MSG, "CCMRAM to RAM in FLASH\n\r");
		  	  		  break;
		  	  	  case CCMRAMtoCCMRAM:
		  	  		  sprintf(gu8_MSG, "CCMRAM to CCMRAM in FLASH\n\r");
		  	  		  break;
		  	  }
		  	  HAL_UART_Transmit(&huart1, gu8_MSG, sizeof(gu8_MSG), 0x1000);
	  }

#ifdef smallsize
	  switch (count){
	  	  			case 0:
	  	  				cpySize = 500;
	  	  				break;
	  	  			case 1:
	  	  				cpySize = 470;
	  	  				break;
	  	  			case 2:
	  	  				cpySize = 440;
	  	  			    break;
	  	  			case 3:
	  	  				cpySize = 410;
	  	  				break;
	  	  			case 4:
	  	  				cpySize = 380;
	  	  				break;
	  	  			case 5:
	  	  				cpySize = 350;
	  	  				break;
	  	  			case 6:
	  	  				cpySize = 320;
	  	  				break;
	  	  			case 7:
	  	  				cpySize = 290;
	  	  				break;
	  	  			case 8:
	  	  				cpySize = 260;
	  	  				break;
	  	  			case 9:
	  	  				cpySize = 230;
	  	  				break;
	  	  			case 10:
	  	  				cpySize = 200;
	  	  				break;
	  	  			case 11:
	  	  				cpySize = 170;
	  	  				break;
	  	  			case 12:
	  	  				cpySize = 140;
	  	  				break;
	  	  			case 13:
	  	  				cpySize = 110;
	  	  				break;
	  	  			case 14:
	  	  				cpySize = 80;
	  	  				break;
	  	  		}
#else
	  switch (count){
	  	  	  	case 0:
					cpySize = 4000;
					break;
	  			case 1:
	  				cpySize = 4000;
	  				break;
	  			case 2:
	  				cpySize = 3500;
	  				break;
	  			case 3:
	  				cpySize = 3000;
	  			    break;
	  			case 4:
	  				cpySize = 2500;
	  				break;
	  			case 5:
	  				cpySize = 2000;
	  				break;
	  			case 6:
	  				cpySize = 1500;
	  				break;
	  			case 7:
	  				cpySize = 1000;
	  				break;
	  			case 8:
	  				cpySize = 500;
	  				break;
	  			case 9:
	  				cpySize = 400;
	  				break;
	  			case 10:
	  				cpySize = 300;
	  				break;
	  			case 11:
	  				cpySize = 200;
	  				break;
	  			case 12:
	  				cpySize = 100;
	  				break;
	  			case 13:
	  				cpySize = 80;
	  				break;
	  			case 14:
	  				cpySize = 60;
	  				break;
	  			case 15:
	  				cpySize = 40;
	  				break;
	  			case 16:
					cpySize = 20;
					break;
	  		}
#endif


	  switch (mode){
	  		  	  	  case FLASHtoRAM:
	  		  	  		  time1 = TIM2->CNT;
#ifdef stdmemcpy
	  		  	  		  memcpy(desArrayInRAM, srcArrayInFlash, cpySize);
#else
	  		  	  		  myMemCpy(desArrayInRAM, srcArrayInFlash, cpySize);
#endif
	  		  	  		  time2 = TIM2->CNT;
			  	  		  break;
	  		  	  	  case RAMtoRAM:
	  		  	  		  time1 = TIM2->CNT;
#ifdef stdmemcpy
	  		  	  		  memcpy(desArrayInRAM, srcArrayInRAM, cpySize);
#else
	  		  	  		  myMemCpy(desArrayInRAM, srcArrayInRAM, cpySize);
#endif
	  		  	  		  time2 = TIM2->CNT;
			  	  		  break;
	  		  	  	  case FLASHtoCCMRAM:/*3*/
	  		  	  		  time1 = TIM2->CNT;
#ifdef stdmemcpy
	  		  	  		  memcpy(arrayInCCMRAM1, srcArrayInFlash, cpySize);
#else
	  		  	  		  myMemCpy(arrayInCCMRAM1, srcArrayInFlash, cpySize);
#endif
	  		  	  		  time2 = TIM2->CNT;
			  	  		  break;
	  		  	  	  case RAMtoCCMRAM:/*4*/
	  		  	  		  time1 = TIM2->CNT;
#ifdef stdmemcpy
	  		  	  		  memcpy(arrayInCCMRAM1, srcArrayInRAM, cpySize);
#else
	  		  	  		  myMemCpy(arrayInCCMRAM1, srcArrayInRAM, cpySize);
#endif
	  		  	  		  time2 = TIM2->CNT;
			  	  		  break;
	  		  	  	  case CCMRAMtoRAM:/*5*/
	  		  	  		  time1 = TIM2->CNT;
#ifdef stdmemcpy
	  		  	  		  memcpy(desArrayInRAM, arrayInCCMRAM1, cpySize);
#else
	  		  	  		  myMemCpy(desArrayInRAM, arrayInCCMRAM1, cpySize);
#endif
	  		  	  		  time2 = TIM2->CNT;
			  	  		  break;
	  		  	  	  case CCMRAMtoCCMRAM:/*6*/
	  		  	  		  time1 = TIM2->CNT;
#ifdef stdmemcpy
	  		  	  		  memcpy(arrayInCCMRAM2, arrayInCCMRAM1, cpySize);
#else
	  		  	  		  myMemCpy(arrayInCCMRAM2, arrayInCCMRAM1, cpySize);
#endif
	  		  	  		  time2 = TIM2->CNT;
			  	  		  break;
	  		  	  }


	  execution_time =(int)((double)(time2-time1)/cpu_frequency*1000);
	  memset(desArrayInRAM, 0, cpySize);
	  if(mode == FLASHtoCCMRAM/*3*/){
		  memset(arrayInCCMRAM1, 0, cpySize);
	  }else if(mode == CCMRAMtoCCMRAM){
		  memset(arrayInCCMRAM1, 0, cpySize);
		  memset(arrayInCCMRAM2, 0, cpySize);
	  }

	  memset(gu8_MSG, 0, sizeof gu8_MSG);

	  sprintf(gu8_MSG, "%ld\n\r",execution_time);
	  HAL_UART_Transmit(&huart1, gu8_MSG, sizeof(gu8_MSG), 0xFFFF);
	  HAL_Delay(200);

	  if(count<16)
	  count++;
	  else {
		  count=0;
		  mode += 1;
		  HAL_Delay(1000);
	  }

	  if(mode > 6){
		  mode = 1;
		  HAL_Delay(90000);
	  }
  }
  /* USER CODE END 3 */
}

/**
  * @brief System Clock Configuration
  * @retval None
  */
void SystemClock_Config(void)
{
  RCC_OscInitTypeDef RCC_OscInitStruct = {0};
  RCC_ClkInitTypeDef RCC_ClkInitStruct = {0};
  RCC_PeriphCLKInitTypeDef PeriphClkInit = {0};

  /** Initializes the RCC Oscillators according to the specified parameters
  * in the RCC_OscInitTypeDef structure.
  */
  RCC_OscInitStruct.OscillatorType = RCC_OSCILLATORTYPE_HSE;
  RCC_OscInitStruct.HSEState = RCC_HSE_ON;
  RCC_OscInitStruct.HSEPredivValue = RCC_HSE_PREDIV_DIV1;
  RCC_OscInitStruct.HSIState = RCC_HSI_ON;
  RCC_OscInitStruct.PLL.PLLState = RCC_PLL_ON;
  RCC_OscInitStruct.PLL.PLLSource = RCC_PLLSOURCE_HSE;
  RCC_OscInitStruct.PLL.PLLMUL = RCC_PLL_MUL3;
  if (HAL_RCC_OscConfig(&RCC_OscInitStruct) != HAL_OK)
  {
    Error_Handler();
  }
  /** Initializes the CPU, AHB and APB buses clocks
  */
  RCC_ClkInitStruct.ClockType = RCC_CLOCKTYPE_HCLK|RCC_CLOCKTYPE_SYSCLK
                              |RCC_CLOCKTYPE_PCLK1|RCC_CLOCKTYPE_PCLK2;
  RCC_ClkInitStruct.SYSCLKSource = RCC_SYSCLKSOURCE_PLLCLK;
  RCC_ClkInitStruct.AHBCLKDivider = RCC_SYSCLK_DIV1;
  RCC_ClkInitStruct.APB1CLKDivider = RCC_HCLK_DIV2;
  RCC_ClkInitStruct.APB2CLKDivider = RCC_HCLK_DIV1;

  if (HAL_RCC_ClockConfig(&RCC_ClkInitStruct, FLASH_LATENCY_0) != HAL_OK)
  {
    Error_Handler();
  }
  PeriphClkInit.PeriphClockSelection = RCC_PERIPHCLK_USART1;
  PeriphClkInit.Usart1ClockSelection = RCC_USART1CLKSOURCE_PCLK2;
  if (HAL_RCCEx_PeriphCLKConfig(&PeriphClkInit) != HAL_OK)
  {
    Error_Handler();
  }
}

/**
  * @brief TIM2 Initialization Function
  * @param None
  * @retval None
  */
static void MX_TIM2_Init(void)
{

  /* USER CODE BEGIN TIM2_Init 0 */

  /* USER CODE END TIM2_Init 0 */

  TIM_ClockConfigTypeDef sClockSourceConfig = {0};
  TIM_MasterConfigTypeDef sMasterConfig = {0};

  /* USER CODE BEGIN TIM2_Init 1 */

  /* USER CODE END TIM2_Init 1 */
  htim2.Instance = TIM2;
  htim2.Init.Prescaler = 0;
  htim2.Init.CounterMode = TIM_COUNTERMODE_UP;
  htim2.Init.Period = 4294967295;
  htim2.Init.ClockDivision = TIM_CLOCKDIVISION_DIV1;
  htim2.Init.AutoReloadPreload = TIM_AUTORELOAD_PRELOAD_ENABLE;
  if (HAL_TIM_Base_Init(&htim2) != HAL_OK)
  {
    Error_Handler();
  }
  sClockSourceConfig.ClockSource = TIM_CLOCKSOURCE_INTERNAL;
  if (HAL_TIM_ConfigClockSource(&htim2, &sClockSourceConfig) != HAL_OK)
  {
    Error_Handler();
  }
  sMasterConfig.MasterOutputTrigger = TIM_TRGO_RESET;
  sMasterConfig.MasterSlaveMode = TIM_MASTERSLAVEMODE_DISABLE;
  if (HAL_TIMEx_MasterConfigSynchronization(&htim2, &sMasterConfig) != HAL_OK)
  {
    Error_Handler();
  }
  /* USER CODE BEGIN TIM2_Init 2 */

  /* USER CODE END TIM2_Init 2 */

}

/**
  * @brief USART1 Initialization Function
  * @param None
  * @retval None
  */
static void MX_USART1_UART_Init(void)
{

  /* USER CODE BEGIN USART1_Init 0 */

  /* USER CODE END USART1_Init 0 */

  /* USER CODE BEGIN USART1_Init 1 */

  /* USER CODE END USART1_Init 1 */
  huart1.Instance = USART1;
  huart1.Init.BaudRate = 38400;
  huart1.Init.WordLength = UART_WORDLENGTH_8B;
  huart1.Init.StopBits = UART_STOPBITS_1;
  huart1.Init.Parity = UART_PARITY_EVEN;
  huart1.Init.Mode = UART_MODE_TX_RX;
  huart1.Init.HwFlowCtl = UART_HWCONTROL_NONE;
  huart1.Init.OverSampling = UART_OVERSAMPLING_16;
  huart1.Init.OneBitSampling = UART_ONE_BIT_SAMPLE_DISABLE;
  huart1.AdvancedInit.AdvFeatureInit = UART_ADVFEATURE_NO_INIT;
  if (HAL_UART_Init(&huart1) != HAL_OK)
  {
    Error_Handler();
  }
  /* USER CODE BEGIN USART1_Init 2 */

  /* USER CODE END USART1_Init 2 */

}

/**
  * @brief GPIO Initialization Function
  * @param None
  * @retval None
  */
static void MX_GPIO_Init(void)
{

  /* GPIO Ports Clock Enable */
  __HAL_RCC_GPIOF_CLK_ENABLE();
  __HAL_RCC_GPIOC_CLK_ENABLE();
  __HAL_RCC_GPIOA_CLK_ENABLE();

}

/* USER CODE BEGIN 4 */

/* USER CODE END 4 */

/**
  * @brief  This function is executed in case of error occurrence.
  * @retval None
  */
void Error_Handler(void)
{
  /* USER CODE BEGIN Error_Handler_Debug */
  /* User can add his own implementation to report the HAL error return state */
  __disable_irq();
  while (1)
  {
  }
  /* USER CODE END Error_Handler_Debug */
}

#ifdef  USE_FULL_ASSERT
/**
  * @brief  Reports the name of the source file and the source line number
  *         where the assert_param error has occurred.
  * @param  file: pointer to the source file name
  * @param  line: assert_param error line source number
  * @retval None
  */
void assert_failed(uint8_t *file, uint32_t line)
{
  /* USER CODE BEGIN 6 */
  /* User can add his own implementation to report the file name and line number,
     ex: printf("Wrong parameters value: file %s on line %d\r\n", file, line) */
  /* USER CODE END 6 */
}
#endif /* USE_FULL_ASSERT */

/************************ (C) COPYRIGHT STMicroelectronics *****END OF FILE****/
