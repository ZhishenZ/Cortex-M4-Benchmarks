/* USER CODE BEGIN Header */
/**
  ******************************************************************************
  * @file           : main.c
  * @brief          : Main program body
  ******************************************************************************
  * @attention
  *
  * <h2><center>&copy; Copyright (c) 2021 STMicroelectronics.
  * All rights reserved.</center></h2>
  *
  * This software component is licensed by ST under BSD 3-Clause license,
  * the "License"; You may not use this file except in compliance with the
  * License. You may obtain a copy of the License at:
  *                        opensource.org/licenses/BSD-3-Clause
  *
  ******************************************************************************
  */
/* USER CODE END Header */
/* Includes ------------------------------------------------------------------*/
#include "main.h"
#include <stdio.h>
/* Private includes ----------------------------------------------------------*/
/* USER CODE BEGIN Includes */

// the generation script is in generate_random_pointer_array.ipynb

/* USER CODE END Includes */

/* Private typedef -----------------------------------------------------------*/
/* USER CODE BEGIN PTD */



#define NUMBER_OF_BITS 13    /* fract format 1.NUMBER_OF_BITS = 1.13 */

#define BITS_PER_TWID 13     /* bits per twiddle coefficient */
#define SHIFT BITS_PER_TWID  /* fractional shift after each multiplication */


//---------------------------------MARCRO for our tests--------------------------------
//----1-----
//#define PROGRAM_ON_CCM

//----2-----
//#define INPUT_DATA_ON_FLASH
//#define INPUT_DATA_ON_CCM

//----3-----
//#define DATA_ON_CCM


#define FFT_1024

//---------------------------------MARCRO for our tests--------------------------------




/*
  Forward declaration of functions
*/

float fft_exp2f( float x );
float fft_modff( float x, float *intpart );
int fft_convert( float value );
void fft_bit_reduct( register int *int_pointer );
void fft_pin_down( int input_data[  ] );
void fft_init( void );
void fft_main( void );
int fft_return( void );
int main( void );

/*
  Forward declaration of global variables
*/

#ifdef FFT_1024

#define N_FFT 1024
#ifdef DATA_ON_CCM
__attribute__((section(".ccmram")))
#endif
int fft_input_data[ 2 * N_FFT ];

/* 1024 real values as input data in float format */






/* 1024 real values as input data in float format */
#ifdef INPUT_DATA_ON_FLASH
const
#endif
#ifdef INPUT_DATA_ON_CCM
__attribute__((section(".ccmram")))
#endif
float fft_input[ 1024 ] = {
  0.243f,  0.323f, 0.505f, -0.176f, -0.87f, 0.353f,  -0.344f, -0.443f,
  -0.434f, -0.32f, 0.232f, -0.454f, -0.32f, -0.323f, -0.733f, 0.54f,
  0.243f,  0.323f, 0.505f, -0.176f, -0.87f, 0.353f,  -0.344f, -0.443f,
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  -0.434f, -0.32f, 0.232f, -0.454f, -0.32f, -0.323f, -0.733f, 0.54f
};

#ifdef DATA_ON_CCM
__attribute__((section(".ccmram")))
#endif
int fft_twidtable[ 2046 ] = {
  8192,  0,     8192,  0,     0,     -8192, 8192,  0,     5792,  -5792, 0,
  -8191, -5792, -5792, 8192,  0,     7568,  -3134, 5792,  -5792, 3134,  -7568,
  0,     -8192, -3134, -7568, -5792, -5792, -7568, -3134, 8192,  0,     8034,
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  -301,  -8188, -251,  -8189, -201,  -8190, -150,  -8191, -100,  -8191, -50
};

#endif


#ifdef FFT_512


#define N_FFT 512
#ifdef DATA_ON_CCM
__attribute__((section(".ccmram")))
#endif
int fft_input_data[ 2 * N_FFT ];

/* precalculated twiddle factors
   for an integer 1024 point FFT
   in format 1.13 => table twidtable[ 2*(N_FFT-1) ] ; */


/* 1024 real values as input data in float format */
#ifdef DATA_ON_CCM
__attribute__((section(".ccmram")))
#endif
int fft_twidtable[ 1022 ] = {
   8192,  0,     8192,  0,     0,     -8192, 8192,  0,     5792,  -5792, 0,
  -8191, -5792, -5792, 8192,  0,     7568,  -3134, 5792,  -5792, 3134,  -7568,
  0,     -8192, -3134, -7568, -5792, -5792, -7568, -3134, 8192,  0,     8034,
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  -8176, -502,  -8182, -401,  -8186, -301,  -8189, -201,  -8191, -100
   
};


/* 1024 real values as input data in float format */

#ifdef INPUT_DATA_ON_FLASH
const
#endif
#ifdef INPUT_DATA_ON_CCM
__attribute__((section(".ccmram")))
#endif
float fft_input[ 512 ] = {
  0.243f,  0.323f, 0.505f, -0.176f, -0.87f, 0.353f,  -0.344f, -0.443f,
  -0.434f, -0.32f, 0.232f, -0.454f, -0.32f, -0.323f, -0.733f, 0.54f,
  0.243f,  0.323f, 0.505f, -0.176f, -0.87f, 0.353f,  -0.344f, -0.443f,
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  -0.434f, -0.32f, 0.232f, -0.454f, -0.32f, -0.323f, -0.733f, 0.54f,
};


#endif


#ifdef FFT_256



#define N_FFT 256
#ifdef DATA_ON_CCM
__attribute__((section(".ccmram")))
#endif
int fft_input_data[ 2 * N_FFT ];

/* precalculated twiddle factors
   for an integer 1024 point FFT
   in format 1.13 => table twidtable[ 2*(N_FFT-1) ] ; */


/* 1024 real values as input data in float format */


#ifdef DATA_ON_CCM
__attribute__((section(".ccmram")))
#endif
int fft_twidtable[ 510 ] = { 8192,  0,     8192,  0,     0,     -8192, 8192,  0,     5792,  -5792, 0,
  -8191, -5792, -5792, 8192,  0,     7568,  -3134, 5792,  -5792, 3134,  -7568,
  0,     -8192, -3134, -7568, -5792, -5792, -7568, -3134, 8192,  0,     8034,
  -1598, 7568,  -3134, 6811,  -4551, 5792,  -5792, 4551,  -6811, 3134,  -7568,
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  -8182, -401,  -8189, -201 };


/* 1024 real values as input data in float format */
#ifdef INPUT_DATA_ON_FLASH
const
#endif
#ifdef INPUT_DATA_ON_CCM
__attribute__((section(".ccmram")))
#endif
float fft_input[ 256 ] = {
  0.243f,  0.323f, 0.505f, -0.176f, -0.87f, 0.353f,  -0.344f, -0.443f,
  -0.434f, -0.32f, 0.232f, -0.454f, -0.32f, -0.323f, -0.733f, 0.54f,
  0.243f,  0.323f, 0.505f, -0.176f, -0.87f, 0.353f,  -0.344f, -0.443f,
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  -0.434f, -0.32f, 0.232f, -0.454f, -0.32f, -0.323f, -0.733f, 0.54f

};



#endif

#ifdef FFT_128


#define N_FFT 128
#ifdef DATA_ON_CCM
__attribute__((section(".ccmram")))
#endif
int fft_input_data[ 2 * N_FFT ];

/* precalculated twiddle factors
   for an integer 1024 point FFT
   in format 1.13 => table twidtable[ 2*(N_FFT-1) ] ; */


/* 1024 real values as input data in float format */

#ifdef DATA_ON_CCM
__attribute__((section(".ccmram")))
#endif
int fft_twidtable[ 254] = { 


8192,  0,     8192,  0,     0,     -8192, 8192,  0,     5792,  -5792, 0,
  -8191, -5792, -5792, 8192,  0,     7568,  -3134, 5792,  -5792, 3134,  -7568,
  0,     -8192, -3134, -7568, -5792, -5792, -7568, -3134, 8192,  0,     8034,
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  -7839, -2378, -7946, -1990, -8034, -1598, -8103, -1202, -8152, -802,  -8182,
  -401
 };


/* 1024 real values as input data in float format */
#ifdef INPUT_DATA_ON_FLASH
const
#endif
#ifdef INPUT_DATA_ON_CCM
__attribute__((section(".ccmram")))
#endif
float fft_input[ 128 ] = {
  0.243f,  0.323f, 0.505f, -0.176f, -0.87f, 0.353f,  -0.344f, -0.443f,
  -0.434f, -0.32f, 0.232f, -0.454f, -0.32f, -0.323f, -0.733f, 0.54f,
  0.243f,  0.323f, 0.505f, -0.176f, -0.87f, 0.353f,  -0.344f, -0.443f,
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  -0.434f, -0.32f, 0.232f, -0.454f, -0.32f, -0.323f, -0.733f, 0.54f

};

#endif


#ifdef FFT_64

#define N_FFT 64
#ifdef DATA_ON_CCM
__attribute__((section(".ccmram")))
#endif
int fft_input_data[ 2 * N_FFT ];


#ifdef DATA_ON_CCM
__attribute__((section(".ccmram")))
#endif
int fft_twidtable[ 126] = { 


8192,  0,     8192,  0,     0,     -8192, 8192,  0,     5792,  -5792, 0,
  -8191, -5792, -5792, 8192,  0,     7568,  -3134, 5792,  -5792, 3134,  -7568,
  0,     -8192, -3134, -7568, -5792, -5792, -7568, -3134, 8192,  0,     8034,
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  -2378, -8034, -1598, -8152, -802
 };


/* 1024 real values as input data in float format */
#ifdef INPUT_DATA_ON_FLASH
const
#endif
#ifdef INPUT_DATA_ON_CCM
__attribute__((section(".ccmram")))
#endif
float fft_input[ 64 ] = {
  0.243f,  0.323f, 0.505f, -0.176f, -0.87f, 0.353f,  -0.344f, -0.443f,
  -0.434f, -0.32f, 0.232f, -0.454f, -0.32f, -0.323f, -0.733f, 0.54f,
  0.243f,  0.323f, 0.505f, -0.176f, -0.87f, 0.353f,  -0.344f, -0.443f,
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  -0.434f, -0.32f, 0.232f, -0.454f, -0.32f, -0.323f, -0.733f, 0.54f

};

#endif


#ifdef FFT_32


#define N_FFT 32
#ifdef DATA_ON_CCM
__attribute__((section(".ccmram")))
#endif
int fft_input_data[ 2 * N_FFT ];

#ifdef DATA_ON_CCM
__attribute__((section(".ccmram")))
#endif
int fft_twidtable[ 62] = { 


8192,  0,     8192,  0,     0,     -8192, 8192,  0,     5792,  -5792, 0,
  -8191, -5792, -5792, 8192,  0,     7568,  -3134, 5792,  -5792, 3134,  -7568,
  0,     -8192, -3134, -7568, -5792, -5792, -7568, -3134, 8192,  0,     8034,
  -1598, 7568,  -3134, 6811,  -4551, 5792,  -5792, 4551,  -6811, 3134,  -7568,
  1598,  -8034, 0,     -8192, -1598, -8034, -3134, -7568, -4551, -6811, -5792,
  -5792, -6811, -4551, -7568, -3134, -8034, -1598
 };


/* 1024 real values as input data in float format */
#ifdef INPUT_DATA_ON_FLASH
const
#endif
#ifdef INPUT_DATA_ON_CCM
__attribute__((section(".ccmram")))
#endif
float fft_input[ 32 ] = {
  0.243f,  0.323f, 0.505f, -0.176f, -0.87f, 0.353f,  -0.344f, -0.443f,
  -0.434f, -0.32f, 0.232f, -0.454f, -0.32f, -0.323f, -0.733f, 0.54f,
  0.243f,  0.323f, 0.505f, -0.176f, -0.87f, 0.353f,  -0.344f, -0.443f,
  -0.434f, -0.32f, 0.232f, -0.454f, -0.32f, -0.323f, -0.733f, 0.54f,

};


#endif


#ifdef FFT_16

#define N_FFT 16
#ifdef DATA_ON_CCM
__attribute__((section(".ccmram")))
#endif
int fft_input_data[ 2 * N_FFT ];

#ifdef DATA_ON_CCM
__attribute__((section(".ccmram")))
#endif
int fft_twidtable[ 30] = { 


8192,  0,     8192,  0,     0,     -8192, 8192,  0,     5792,  -5792, 0,
  -8191, -5792, -5792, 8192,  0,     7568,  -3134, 5792,  -5792, 3134,  -7568,
  0,     -8192, -3134, -7568, -5792, -5792, -7568, -3134
 };


/* 1024 real values as input data in float format */
#ifdef INPUT_DATA_ON_FLASH
const
#endif
#ifdef INPUT_DATA_ON_CCM
__attribute__((section(".ccmram")))
#endif
float fft_input[ 16 ] = {
  0.243f,  0.323f, 0.505f, -0.176f, -0.87f, 0.353f,  -0.344f, -0.443f,
  -0.434f, -0.32f, 0.232f, -0.454f, -0.32f, -0.323f, -0.733f, 0.54f,

};

#endif


#ifdef FFT_8

#define N_FFT 8
#ifdef DATA_ON_CCM
__attribute__((section(".ccmram")))
#endif
int fft_input_data[ 2 * N_FFT ];

/* precalculated twiddle factors
   for an integer 1024 point FFT
   in format 1.13 => table twidtable[ 2*(N_FFT-1) ] ; */


/* 1024 real values as input data in float format */

#ifdef DATA_ON_CCM
__attribute__((section(".ccmram")))
#endif
int fft_twidtable[ 14] = { 


8192,  0,     8192,  0,     0,     -8192, 8192,  0,     5792,  -5792, 0,
  -8191, -5792, -5792};


/* 1024 real values as input data in float format */
#ifdef INPUT_DATA_ON_FLASH
const
#endif
#ifdef INPUT_DATA_ON_CCM
__attribute__((section(".ccmram")))
#endif
float fft_input[ 8 ] = {
  0.243f,  0.323f, 0.505f, -0.176f, -0.87f, 0.353f,  -0.344f, -0.443f
};



#endif








#ifdef FFT_4

#define N_FFT 4

#ifdef DATA_ON_CCM
__attribute__((section(".ccmram")))
#endif
int fft_input_data[ 2 * N_FFT ];

/* precalculated twiddle factors
   for an integer 1024 point FFT
   in format 1.13 => table twidtable[ 2*(N_FFT-1) ] ; */


/* 1024 real values as input data in float format */

#ifdef DATA_ON_CCM
__attribute__((section(".ccmram")))
#endif
int fft_twidtable[ 6] = { 


8192,  0,     8192,  0,     0,     -8192};


/* 1024 real values as input data in float format */
#ifdef INPUT_DATA_ON_FLASH
const
#endif
#ifdef INPUT_DATA_ON_CCM
__attribute__((section(".ccmram")))
#endif
float fft_input[ 4 ] = {
  0.243f,  0.323f, 0.505f, -0.176f
};


#endif

/* will hold the transformed data */
#ifdef DATA_ON_CCM
__attribute__((section(".ccmram")))
#endif
int fft_inputfract[ N_FFT ];


/*
  Algorithm core function
*/
#ifdef PROGRAM_ON_CCM
__attribute__((section(".ccmram")))
#endif
void fft_bit_reduct( register int *int_pointer )
{
  register int i, j = 0  ;
  register int tmpr, max = 2, m, n = N_FFT << 1 ;

  /* do the bit reversal scramble of the input data */
  for ( i = 0; i < ( n - 1 ) ; i += 2 ) {
    if ( j > i ) {
      tmpr = *( int_pointer + j ) ;
      *( int_pointer + j ) = *( int_pointer + i ) ;
      *( int_pointer + i ) = tmpr ;

      tmpr = *( int_pointer + j + 1 ) ;
      *( int_pointer + j + 1 ) = *( int_pointer + i + 1 ) ;
      *( int_pointer + i + 1 ) = tmpr ;
    }

    m = N_FFT;

    while ( m >= 2 && j >= m ) {
      j -= m ;
      m >>= 1;
    }
    j += m ;
  }

  {
    register int *data_pointer = &fft_twidtable[ 0 ] ;
    register int *p, *q ;
    register int tmpi, fr = 0, level, k, l ;

    while ( n > max ) {
      level = max << 1;


      for ( m = 1; m < max; m += 2 ) {
        l = *( data_pointer + fr );
        k = *( data_pointer + fr + 1 ) ;
        fr += 2 ;


        for ( i = m; i <= n; i += level ) {
          j = i + max;
          p = int_pointer + j;
          q = int_pointer + i;

          tmpr  = l * *( p - 1 );
          tmpr -= ( k * *p );

          tmpi  = l * *p;
          tmpi += ( k * *( p - 1 ) );

          tmpr  = tmpr >> SHIFT ;
          tmpi  = tmpi >> SHIFT ;

          *( p - 1 ) = *( q - 1 ) - tmpr ;
          *p     = *q - tmpi ;

          *( q - 1 ) += tmpr ;
          *q     += tmpi ;
        }
      }

      /* implement unconditional bit reduction */

      {
        register int f;

        p = int_pointer;

        for ( f = 0 ; f < 2 * N_FFT; f++ ) {
          *p = *p >> 1;
          p++;
        }
      }

      max = level;
    }
  }
}


/*
  Initialization- and return-value-related functions
*/

/* conversion function to 1.NUMBER_OF_BITS format */
#ifdef PROGRAM_ON_CCM
__attribute__((section(".ccmram")))
#endif
float fft_exp2f( float x )
{
  int i;
  float ret = 2.0f;

 
  for ( i = 1; i < x; ++i )
    ret *= 2.0f;

  return ret;
}

#ifdef PROGRAM_ON_CCM
__attribute__((section(".ccmram")))
#endif
float fft_modff( float x, float *intpart )
{
  if ( intpart ) {
    *intpart = ( int )x;
    return x - *intpart;
  } else
    return x;
}


/* conversion function to 1.NUMBER_OF_BITS format */
#ifdef PROGRAM_ON_CCM
__attribute__((section(".ccmram")))
#endif
int fft_convert( float value )
{
  float man, t_val, frac, m, exponent = NUMBER_OF_BITS;
  int rnd_val;
  unsigned long int_val;
  unsigned long pm_val;

  m = fft_exp2f( exponent + 1 )  - 1;

  t_val = value * m ;
  frac = fft_modff( t_val, &man );
  if ( frac < 0.0f ) {
    rnd_val = ( -1 );
    if ( frac > -0.5f ) rnd_val = 0;
  } else {
    rnd_val = 1;
    if ( frac < 0.5f ) rnd_val = 0;
  }
  int_val = (long)man + (long)rnd_val;

  pm_val = int_val ;
  return ( ( int ) ( pm_val ) ) ;
}

#ifdef PROGRAM_ON_CCM
__attribute__((section(".ccmram")))
#endif
void fft_float2fract( void )
{
  float f ;
  int   j, i ;

  for ( j = 0 ; j < N_FFT ; j++ ) {
    f = fft_input[ j ];
    i = fft_convert( f );
    fft_inputfract[ j ] = i;
  }
}

#ifdef PROGRAM_ON_CCM
__attribute__((section(".ccmram")))
#endif
void fft_pin_down( int input_data[  ] )
{
  /* conversion from input to a 1.13 format */
  fft_float2fract() ;

  int *pd, *ps, f;

  pd = &input_data[ 0 ];
  ps = &fft_inputfract[ 0 ];

  for ( f = 0; f < N_FFT; f++ ) {
    *pd++ = *ps++  ; /* fill in with real data */
    *pd++ = 0 ;      /* imaginary data is equal zero */
  }
}

#ifdef PROGRAM_ON_CCM
__attribute__((section(".ccmram")))
#endif
void fft_init( void )
{
  int i;
  volatile int x = 0;

  fft_pin_down( &fft_input_data[ 0 ] );

  /* avoid constant propagation of input values */
  for ( i = 0; i < 2 * ( N_FFT - 1 ); i++ ) {
    fft_input_data[ i ] += x;
    fft_twidtable[ i ] += x;
  }
  for ( ; i < 2 * N_FFT; i++ )
    fft_input_data[ i ] += x;

}

/*
  Main functions
*/
#ifdef PROGRAM_ON_CCM
__attribute__((section(".ccmram")))
#endif
void fft_main( void )
{
  fft_bit_reduct( &fft_input_data[ 0 ] );
}


/* USER CODE END PTD */

/* Private define ------------------------------------------------------------*/
/* USER CODE BEGIN PD */
/* USER CODE END PD */

/* Private macro -------------------------------------------------------------*/
/* USER CODE BEGIN PM */

/* USER CODE END PM */

/* Private variables ---------------------------------------------------------*/
TIM_HandleTypeDef htim2;

UART_HandleTypeDef huart1;

/* USER CODE BEGIN PV */

/* USER CODE END PV */

/* Private function prototypes -----------------------------------------------*/
void SystemClock_Config(void);
static void MX_GPIO_Init(void);
static void MX_TIM2_Init(void);
static void MX_USART1_UART_Init(void);
/* USER CODE BEGIN PFP */

/* USER CODE END PFP */

/* Private user code ---------------------------------------------------------*/
/* USER CODE BEGIN 0 */
/* USER CODE END 0 */

/**
  * @brief  The application entry point.
  * @retval int
  */
int main(void)
{
  /* USER CODE BEGIN 1 */
    int time1 __attribute__((aligned (4))) = 0;
    int time2 __attribute__((aligned (4))) = 0;

  //void **this_pp = p0;
  /* USER CODE END 1 */

  /* MCU Configuration--------------------------------------------------------*/

  /* Reset of all peripherals, Initializes the Flash interface and the Systick. */
  HAL_Init();

  /* USER CODE BEGIN Init */

  /* USER CODE END Init */

  /* Configure the system clock */
  SystemClock_Config();

  /* USER CODE BEGIN SysInit */

  /* USER CODE END SysInit */

  /* Initialize all configured peripherals */
  MX_GPIO_Init();
  MX_TIM2_Init();
  MX_USART1_UART_Init();
  /* USER CODE BEGIN 2 */
//  int n = 1000;
//  TIM2->CR1&=~TIM_CR1_DIR;

  // enable update interrupts
  TIM2->DIER|=TIM_DIER_UIE;
  //NVIC_EnableIRQ(TIM2_IRQn);



  //start the timer
  HAL_TIM_Base_Start(&htim2);
  //set the over flow counter to 0
  overflow_cnt = 0;

  time1 = TIM2->CNT;





  fft_init();

  fft_main();

  time2 = TIM2->CNT;
  tim_cnt = time2 -time1;

  execution_time = overflow_cnt*1000 + (double)tim_cnt/(1000);
  uint8_t msg[40] = {'\0'};

  sprintf(msg,"\n\r%d", (int)(execution_time*1000));
  HAL_UART_Transmit(&huart1, msg, sizeof(msg), 0xffff);
  //execution time is in ms

  /* USER CODE END 2 */

  /* Infinite loop */
  /* USER CODE BEGIN WHILE */

  int i = 0;
  //measure 5 times
  while (i<4)
  {
	  overflow_cnt = 0;

	  time1 = TIM2->CNT;

	  fft_init();

	  fft_main();

	  time2 = TIM2->CNT;
	  tim_cnt = time2 -time1;

	  execution_time = overflow_cnt*1000 + (double)tim_cnt/(1000);
	  uint8_t msg[40] = {'\0'};

	  sprintf(msg,"\n\r%d", (int)(execution_time*1000));
	  HAL_UART_Transmit(&huart1, msg, sizeof(msg), 0xffff);
	  i++;
    /* USER CODE END WHILE */

    /* USER CODE BEGIN 3 */
  }
  return 0;
  /* USER CODE END 3 */
}

/**
  * @brief System Clock Configuration
  * @retval None
  */
void SystemClock_Config(void)
{
  RCC_OscInitTypeDef RCC_OscInitStruct = {0};
  RCC_ClkInitTypeDef RCC_ClkInitStruct = {0};
  RCC_PeriphCLKInitTypeDef PeriphClkInit = {0};

  /** Initializes the RCC Oscillators according to the specified parameters
  * in the RCC_OscInitTypeDef structure.
  */
  RCC_OscInitStruct.OscillatorType = RCC_OSCILLATORTYPE_HSE;
  RCC_OscInitStruct.HSEState = RCC_HSE_ON;
  RCC_OscInitStruct.HSEPredivValue = RCC_HSE_PREDIV_DIV1;
  RCC_OscInitStruct.HSIState = RCC_HSI_ON;
  RCC_OscInitStruct.PLL.PLLState = RCC_PLL_ON;
  RCC_OscInitStruct.PLL.PLLSource = RCC_PLLSOURCE_HSE;
  RCC_OscInitStruct.PLL.PLLMUL = RCC_PLL_MUL3;
  if (HAL_RCC_OscConfig(&RCC_OscInitStruct) != HAL_OK)
  {
    Error_Handler();
  }
  /** Initializes the CPU, AHB and APB buses clocks
  */
  RCC_ClkInitStruct.ClockType = RCC_CLOCKTYPE_HCLK|RCC_CLOCKTYPE_SYSCLK
                              |RCC_CLOCKTYPE_PCLK1|RCC_CLOCKTYPE_PCLK2;
  RCC_ClkInitStruct.SYSCLKSource = RCC_SYSCLKSOURCE_PLLCLK;
  RCC_ClkInitStruct.AHBCLKDivider = RCC_SYSCLK_DIV1;
  RCC_ClkInitStruct.APB1CLKDivider = RCC_HCLK_DIV2;
  RCC_ClkInitStruct.APB2CLKDivider = RCC_HCLK_DIV1;

  if (HAL_RCC_ClockConfig(&RCC_ClkInitStruct, FLASH_LATENCY_0) != HAL_OK)
  {
    Error_Handler();
  }
  PeriphClkInit.PeriphClockSelection = RCC_PERIPHCLK_USART1;
  PeriphClkInit.Usart1ClockSelection = RCC_USART1CLKSOURCE_PCLK2;
  if (HAL_RCCEx_PeriphCLKConfig(&PeriphClkInit) != HAL_OK)
  {
    Error_Handler();
  }
}

/**
  * @brief TIM2 Initialization Function
  * @param None
  * @retval None
  */
static void MX_TIM2_Init(void)
{

  /* USER CODE BEGIN TIM2_Init 0 */

  /* USER CODE END TIM2_Init 0 */

  TIM_ClockConfigTypeDef sClockSourceConfig = {0};
  TIM_MasterConfigTypeDef sMasterConfig = {0};

  /* USER CODE BEGIN TIM2_Init 1 */

  /* USER CODE END TIM2_Init 1 */
  htim2.Instance = TIM2;
  htim2.Init.Prescaler = (24-1);
  htim2.Init.CounterMode = TIM_COUNTERMODE_UP;
  htim2.Init.Period = (1000000-1);
  htim2.Init.ClockDivision = TIM_CLOCKDIVISION_DIV1;
  htim2.Init.AutoReloadPreload = TIM_AUTORELOAD_PRELOAD_DISABLE;
  if (HAL_TIM_Base_Init(&htim2) != HAL_OK)
  {
    Error_Handler();
  }
  sClockSourceConfig.ClockSource = TIM_CLOCKSOURCE_INTERNAL;
  if (HAL_TIM_ConfigClockSource(&htim2, &sClockSourceConfig) != HAL_OK)
  {
    Error_Handler();
  }
  sMasterConfig.MasterOutputTrigger = TIM_TRGO_RESET;
  sMasterConfig.MasterSlaveMode = TIM_MASTERSLAVEMODE_DISABLE;
  if (HAL_TIMEx_MasterConfigSynchronization(&htim2, &sMasterConfig) != HAL_OK)
  {
    Error_Handler();
  }
  /* USER CODE BEGIN TIM2_Init 2 */

  /* USER CODE END TIM2_Init 2 */

}

/**
  * @brief USART1 Initialization Function
  * @param None
  * @retval None
  */
static void MX_USART1_UART_Init(void)
{

  /* USER CODE BEGIN USART1_Init 0 */

  /* USER CODE END USART1_Init 0 */

  /* USER CODE BEGIN USART1_Init 1 */

  /* USER CODE END USART1_Init 1 */
  huart1.Instance = USART1;
  huart1.Init.BaudRate = 38400;
  huart1.Init.WordLength = UART_WORDLENGTH_8B;
  huart1.Init.StopBits = UART_STOPBITS_1;
  huart1.Init.Parity = UART_PARITY_NONE;
  huart1.Init.Mode = UART_MODE_TX_RX;
  huart1.Init.HwFlowCtl = UART_HWCONTROL_NONE;
  huart1.Init.OverSampling = UART_OVERSAMPLING_16;
  huart1.Init.OneBitSampling = UART_ONE_BIT_SAMPLE_DISABLE;
  huart1.AdvancedInit.AdvFeatureInit = UART_ADVFEATURE_NO_INIT;
  if (HAL_UART_Init(&huart1) != HAL_OK)
  {
    Error_Handler();
  }
  /* USER CODE BEGIN USART1_Init 2 */

  /* USER CODE END USART1_Init 2 */

}

/**
  * @brief GPIO Initialization Function
  * @param None
  * @retval None
  */
static void MX_GPIO_Init(void)
{

  /* GPIO Ports Clock Enable */
  __HAL_RCC_GPIOF_CLK_ENABLE();
  __HAL_RCC_GPIOC_CLK_ENABLE();

}

/* USER CODE BEGIN 4 */
void HAL_TIM_PeriodElapsedCallback(TIM_HandleTypeDef* htim)
{
	overflow_cnt++;

}



/* USER CODE END 4 */

/**
  * @brief  This function is executed in case of error occurrence.
  * @retval None
  */
void Error_Handler(void)
{
  /* USER CODE BEGIN Error_Handler_Debug */
  /* User can add his own implementation to report the HAL error return state */
  __disable_irq();
  while (1)
  {
  }
  /* USER CODE END Error_Handler_Debug */
}

#ifdef  USE_FULL_ASSERT
/**
  * @brief  Reports the name of the source file and the source line number
  *         where the assert_param error has occurred.
  * @param  file: pointer to the source file name
  * @param  line: assert_param error line source number
  * @retval None
  */
void assert_failed(uint8_t *file, uint32_t line)
{
  /* USER CODE BEGIN 6 */
  /* User can add his own implementation to report the file name and line number,
     ex: printf("Wrong parameters value: file %s on line %d\r\n", file, line) */
  /* USER CODE END 6 */
}
#endif /* USE_FULL_ASSERT */

/************************ (C) COPYRIGHT STMicroelectronics *****END OF FILE****/
